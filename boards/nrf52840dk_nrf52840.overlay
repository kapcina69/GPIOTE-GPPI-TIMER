// /*
//  * Device Tree Overlay for MCP4725 DAC on I2C (nRF52840DK)
//  * Enables TWIM0 (I2C0) for DAC communication
//  * Enables SPIM2 for MUX driver
//  */




&spi2 {
    compatible = "nordic,nrf-spim";
    status = "okay";
    pinctrl-0 = <&spi2_default>;
    pinctrl-1 = <&spi2_sleep>;
    pinctrl-names = "default", "sleep";
};

&spi1 {
    compatible = "nordic,nrf-spim";
    status = "okay";
    pinctrl-0 = <&spi1_default>;
    pinctrl-1 = <&spi1_sleep>;
    pinctrl-names = "default", "sleep";
};

// Disable default uart1 if it exists
&uart1 {
    status = "disabled";
};


&uart0 {
    status = "disabled";
};


// // Reserve pins for nrfx_uarte driver
// &pinctrl {
//     uart1_default_alt: uart1_default_alt {
//         group1 {
//             psels = <NRF_PSEL(UART_TX, 0, 6)>,
//                     <NRF_PSEL(UART_RX, 0, 8)>;
//         };
//     };

//     uart1_sleep_alt: uart1_sleep_alt {
//         group1 {
//             psels = <NRF_PSEL(UART_TX, 0, 6)>,
//                     <NRF_PSEL(UART_RX, 0, 8)>;
//             low-power-enable;
//         };
//     };
// };

